## main/Kconfig.projbuild
```kconfig
menu "esp-neo-miata-reflector"
    
    orsource "$IDF_PATH/examples/common_components/env_caps/$IDF_TARGET/Kconfig.env_caps"

    menu "pinout"
        config BOARD_LED_PIN
            int "LED pin"
            range ENV_GPIO_RANGE_MIN ENV_GPIO_OUT_RANGE_MAX
            default 4
        
        config BOARD_LED_STRIP_PIN
            int "LED strip pin"
            range ENV_GPIO_RANGE_MIN ENV_GPIO_OUT_RANGE_MAX
            default 5
            help 
                The pin number of the LED strip data line.
        
        config BOARD_SENS1_PIN
            int "Sensor 1 pin"
            range ENV_GPIO_RANGE_MIN ENV_GPIO_IN_RANGE_MAX
            default 6
            help 
                The pin number of the first voltage sensor.
    
        config BOARD_SENS2_PIN
            int "Sensor 2 pin"
            range ENV_GPIO_RANGE_MIN ENV_GPIO_IN_RANGE_MAX
            default 7
            help 
                The pin number of the second voltage sensor.
    endmenu

    menu "led strip"
        config LED_STRIP_NUM_LEDS
            int "Number of LEDs"
            range 1 200
            default 15
            help 
                The number of LEDs in the LED strip.

        config LED_STRIP_FPS
            int "Frames per second"
            range 1 60
            default 30
            help 
                The number of frames per second the LED strip should be updated with.
    endmenu

    menu "blinker event source"
        config BLINKER_EVENT_SOURCE_MAX_OFF_TIME_DIFF_MS
            int "Max off time difference"
            range 0 10000
            default 200
            help 
                The maximum difference between the off time of the current and the previous blinking mode.
    endmenu

    menu "stack manager modes"
        menu "idle_mode"
            config IDLE_MODE_ID
                int "Idle mode id"
                range 0 255
                default 0
        endmenu

        menu "blinking_mode"
            config BLINKING_MODE_ID
                int "Blinking mode id"
                range 0 255
                default 1

            config BLINKING_MODE_PRIO
                int "Blinking mode priority"
                range 0 255
                default 2
        endmenu
    endmenu

    menu "tasks"

        menu "mode stack manager"
            config MODE_STACK_MANAGER_TASK_PRIORITY
                int "Mode stack task priority"
                range 0 10
                default 1
                help 
                    The priority of the mode stack task.
            
            config MODE_STACK_MANAGER_TASK_STACK_SIZE
                int "Mode stack task stack size"
                range 512 8192
                default 4096
                help 
                    The size of the mode stack task stack.
        endmenu

        menu "state manager"
            config STATE_MANAGER_EVENT_LOOP_PRIORITY
                int "State manager event loop priority"
                range 0 10
                default 2
                help 
                    The priority of the state manager event loop task.

            config STATE_MANAGER_EVENT_QUEUE_SIZE
                int "State manager event queue size"
                range 1 100
                default 10
                help 
                    The size of the state manager event queue.

            config STATE_MANAGER_EVENT_LOOP_STACK_SIZE
                int "State manager event loop stack size"
                range 512 8192
                default 4096
                help 
                    The size of the state manager event loop stack.
        endmenu

        menu "config manager"
            config CONFIG_MANAGER_EVENT_LOOP_PRIORITY
                int "Config manager event loop task priority"
                range 0 10
                default 2
                help 
                    The priority of the config manager task.

            config CONFIG_MANAGER_EVENT_QUEUE_SIZE
                int "Config manager event queue size"
                range 1 100
                default 10
                help 
                    The size of the config manager event queue.

            config CONFIG_MANAGER_EVENT_LOOP_STACK_SIZE
                int "Config manager event loop stack size"
                range 512 8192
                default 4096
                help 
                    The size of the config manager event loop stack.
        endmenu

        menu "mode event linker"
            config MODE_EVENT_LINKER_EVENT_LOOP_PRIORITY
                int "Mode event linker event loop task priority"
                range 0 10
                default 0
                help 
                    The priority of the config manager task.

            config MODE_EVENT_LINKER_EVENT_QUEUE_SIZE
                int "Mode event linker event queue size"
                range 1 100
                default 10
                help 
                    The size of the config manager event queue.

            config MODE_EVENT_LINKER_EVENT_LOOP_STACK_SIZE
                int "Mode event linker event loop stack size"
                range 512 8192
                default 4096
                help 
                    The size of the config manager event loop stack.
        endmenu

        menu "sense wire event source"
            config SENSE_WIRE_EVENT_SOURCE_TIMER_INTERVAL_MS
                int "Sense wire event source timer interval"
                range 2 20
                default 5
                help 
                    The interval of the sense wire event source timer.
        endmenu
    endmenu
endmenu
```
